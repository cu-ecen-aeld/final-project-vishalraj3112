## backup/meta-aesdsocket_new/conf/layer.conf
```bitbake
# We have a conf and classes directory, add to BBPATH
BBPATH .= ":${LAYERDIR}"

# We have recipes-* directories, add to BBFILES
BBFILES += "${LAYERDIR}/recipes-*/*/*.bb \
            ${LAYERDIR}/recipes-*/*/*.bbappend"

BBFILE_COLLECTIONS += "meta-aesdsocket_new"
BBFILE_PATTERN_meta-aesdsocket_new = "^${LAYERDIR}/"
BBFILE_PRIORITY_meta-aesdsocket_new= "6"

LAYERDEPENDS_meta-aesdsocket_new = "core"
LAYERSERIES_COMPAT_meta-aesdsocket_new = "kirkstone"
```

## backup/meta-cserver/meta-cserver/conf/layer.conf
```bitbake
# We have a conf and classes directory, add to BBPATH
BBPATH .= ":${LAYERDIR}"

# We have recipes-* directories, add to BBFILES
BBFILES += "${LAYERDIR}/recipes-*/*/*.bb \
            ${LAYERDIR}/recipes-*/*/*.bbappend"

BBFILE_COLLECTIONS += "meta-cserver"
BBFILE_PATTERN_meta-cserver = "^${LAYERDIR}/"
BBFILE_PRIORITY_meta-cserver = "6"

LAYERDEPENDS_meta-cserver = "core"
LAYERSERIES_COMPAT_meta-cserver = "kirkstone"
```

## meta-aesdsocket-new/conf/layer.conf
```bitbake
# We have a conf and classes directory, add to BBPATH
BBPATH .= ":${LAYERDIR}"

# We have recipes-* directories, add to BBFILES
BBFILES += "${LAYERDIR}/recipes-*/*/*.bb \
            ${LAYERDIR}/recipes-*/*/*.bbappend"

BBFILE_COLLECTIONS += "meta-aesdsocket-new"
BBFILE_PATTERN_meta-aesdsocket-new = "^${LAYERDIR}/"
BBFILE_PRIORITY_meta-aesdsocket-new= "6"

LAYERDEPENDS_meta-aesdsocket-new = "core"
LAYERSERIES_COMPAT_meta-aesdsocket-new = "kirkstone"
```
